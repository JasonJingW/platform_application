## task/kconfig
```kconfig
menu "Tasks"

menu "Heartbeat task"

config HEARTBEAT_ENABLED
    bool "Enable task by default (build backend may override)"
    default y
    help
      Default input to build/gcc when GCC_HEARTBEAT=AUTO. Final compilation
      is selected by the root build backend. The task manager safely skips
      a task whose source was excluded from the firmware.

config HEARTBEAT_TASK_PRIORITY
    int "Task priority"
    range 0 31
    default 1
    help
      Higher numbers mean higher task priority. Must be less than
      RTOS_MAX_PRIORITIES; priority zero is the idle priority.

config HEARTBEAT_TASK_NAME
    string "Task name"
    default "heartbeat"

config HEARTBEAT_TASK_STACK_DEPTH
    int "Stack depth (32-bit words)"
    range 128 16384
    default 512

config HEARTBEAT_TASK_PERIOD_MS
    int "Scheduling period (milliseconds)"
    range 1 60000
    default 50
    help
      Fixed-period scheduling with xTaskDelayUntil. Task execution time does
      not accumulate into the period; execution overruns can still miss deadlines.

config HEARTBEAT_TASK_START_DELAY_MS
    int "Startup delay (milliseconds)"
    range 0 60000
    default 0
    help
      Delay before the first LED toggle, measured from when this task starts.
      The fixed scheduling period starts after this delay.

endmenu

endmenu
```
